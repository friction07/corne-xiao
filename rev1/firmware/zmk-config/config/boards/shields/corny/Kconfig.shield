## rev1/firmware/zmk-config/config/boards/shields/corny/Kconfig.shield
```kconfig
config SHIELD_CORNY_LEFT
    def_bool $(shields_list_contains,corny_left)

config SHIELD_CORNY_RIGHT
    def_bool $(shields_list_contains,corny_right)
```

## rev2/firmware/6-col/zmk-config/boards/shields/corny/Kconfig.defconfig
```kconfig
if SHIELD_CORNY_LEFT

config ZMK_KEYBOARD_NAME
    default "Corne"

config ZMK_SPLIT_ROLE_CENTRAL
    default y

endif

if SHIELD_CORNY_LEFT || SHIELD_CORNY_RIGHT

config ZMK_SPLIT
    default y

endif
```

## rev2/firmware/6-col/zmk-config/config/west.yml
```yaml
manifest:
  remotes:
    - name: zmkfirmware
      url-base: https://github.com/zmkfirmware
    - name: caksoylar
      url-base: https://github.com/caksoylar
  projects:
    - name: zmk
      remote: zmkfirmware
      revision: main
      import: app/west.yml
    - name: zmk-rgbled-widget
      remote: caksoylar
      revision: main
  self:
    path: config
```
